## zmk-config-newAge/config/boards/shields/newAge/Kconfig.shield
```kconfig
config SHIELD_NEWAGE_LEFT
    def_bool $(shields_list_contains,newAge_left)

config SHIELD_NEWAGE_RIGHT
    def_bool $(shields_list_contains,newAge_right)
```
